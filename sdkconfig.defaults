## sdkconfig.defaults
```kconfig
# Rust often needs a bit of extra main task stack size compared to C
CONFIG_ESP_MAIN_TASK_STACK_SIZE=8000

# Enable BLE with NimBLE (required by esp32-nimble)
CONFIG_BT_ENABLED=y
CONFIG_BT_BLE_ENABLED=y
CONFIG_BT_BLUEDROID_ENABLED=n
CONFIG_BT_NIMBLE_ENABLED=y

CONFIG_BTDM_CTRL_MODE_BLE_ONLY=y
CONFIG_BTDM_CTRL_PINNED_TO_CORE=0

# Use default partition table
CONFIG_PARTITION_TABLE_SINGLE_APP=y
```
